## conf/layer.conf
```bitbake
# We have a conf and classes directory, add to BBPATH
BBPATH .= ":${LAYERDIR}:${LAYERDIR}/include"

# We have a recipes-* directories, add to BBFILES
BBFILES += "${LAYERDIR}/recipes-*/*/*.bb \
	${LAYERDIR}/recipes-*/*/*.bbappend \
	${LAYERDIR}/backports-*/recipes-*/*/*.bb \
	${LAYERDIR}/backports-*/recipes-*/*/*.bbappend"

BBFILE_COLLECTIONS += "skov-cpu-bsp"
BBFILE_PATTERN_skov-cpu-bsp = "^${LAYERDIR}/"
BBFILE_PRIORITY_skov-cpu-bsp = "9"

LAYERSERIES_COMPAT_skov-cpu-bsp = "scarthgap kirkstone"

# Define required partition type UUIDs, see
# https://en.wikipedia.org/wiki/GUID_Partition_Table#Partition_type_GUIDs
PART_TYPE_BAREBOX_ENV    = "6C3737F2-07F8-45D1-AD45-15D260AAB24D"
PART_TYPE_BAREBOX_STATE  = "4778ED65-BF42-45FA-9C5B-287A1DC4AAB1"
PART_TYPE_LINUX_RESERVED = "8DA63339-0007-60C0-C436-083AC8230908"
PART_TYPE_ROOT_ARM       = "69DAD710-2CE4-4E3C-B16C-21A1D49ABED3"
PART_TYPE_ROOT_ARM64     = "B921B045-1DF0-41C3-AF44-4C6F280D3FAE"
PART_TYPE_HOME           = "933AC7E1-2EB4-4F13-B844-0E14E2AEF915"
```

## conf/machine/arm9-cpu.conf
```bitbake
#@TYPE: Machine
#@NAME: ARM9
#@DESCRIPTION: Common machine configuration for all ARM9 variants

require conf/machine/include/soc-family.inc

MACHINEOVERRIDES .= ":arm9-cpu"

MACHINE_EXTRA_RRECOMMENDS = " kernel-modules"

EXTRA_IMAGEDEPENDS += "virtual/bootloader"

require conf/machine/include/arm/armv5/tune-arm926ejs.inc

IMAGE_FSTYPES += "tar.bz2 ext4"

SERIAL_CONSOLES = "115200;ttyS0"

PREFERRED_PROVIDER_virtual/bootloader = "barebox"
PREFERRED_PROVIDER_virtual/kernel ?= "linux-skov"

BAREBOX_IMAGE = "barebox-skov-arm9cpu.img"

KERNEL_IMAGETYPE = "zImage"

MACHINE_FEATURES = "usbhost vfat touchscreen serial rtc"

SOC_FAMILY = "at91sam"

# The image's target medium decides indirectly which IMAGE_FSTYPES are created.
# It is set to "NAND" per default here and can be overwritten to be "SD" in your
# local.conf or from the bitbake-commandline via
#   $ env TARGET_MEDIUM="SD" BB_ENV_PASSTHROUGH_ADDITIONS="$BB_ENV_PASSTHROUGH_ADDITIONS" bitbake [...]
TARGET_MEDIUM ?= "NAND"
```

## conf/machine/at91sam9m10g45ek.conf
```bitbake
#@TYPE: Machine
#@NAME: ARM9
#@DESCRIPTION: Common machine configuration for all ARM9 variants

include conf/machine/include/soc-family.inc

MACHINEOVERRIDES .= ":at91sam9m10g45ek"

MACHINE_EXTRA_RRECOMMENDS = " kernel-modules kernel-devicetree"
MACHINE_ESSENTIAL_EXTRA_RDEPENDS = "tslib-calibrate-init"

EXTRA_IMAGECMD_squashfs = "-comp lzo -b 128K -no-xattrs"
EXTRA_IMAGEDEPENDS += "virtual/bootloader"

require conf/machine/include/tune-arm926ejs.inc

IMAGE_FSTYPES += "tar.bz2 squashfs"

SERIAL_CONSOLE = "115200 ttyS0"

UBOOT_MACHINE = "${MACHINE}_nandflash_config"
UBOOT_ENTRYPOINT = "0x70008000"
UBOOT_LOADADDRESS = "0x70008000"

#PREFERRED_PROVIDER_virtual/bootloader ?= "u-boot-at91"

#PREFERRED_PROVIDER_virtual/kernel ?= "linux-at91"

KERNEL_IMAGETYPE = "zImage"
KERNEL_DEVICETREE = "\
 at91sam9m10g45ek.dtb \
 "

MACHINE_FEATURES = "usbgadget usbhost vfat touchscreen serial rtc"

SOC_FAMILY = "at91sam"
```

## conf/machine/dol-63x-hp.conf
```bitbake
#@TYPE: Machine
#@NAME: DOL-63x-hp
#@DESCRIPTION: Machine configuration for DOL-63x High Performance variant

include conf/machine/dol-63x.inc
```

## conf/machine/dol-63x-lc.conf
```bitbake
#@TYPE: Machine
#@NAME: DOL-63x-lc
#@DESCRIPTION: Machine configuration for DOL-63x Low Cost variant

include conf/machine/dol-63x.inc
```

## conf/machine/dol-63x-mp.conf
```bitbake
#@TYPE: Machine
#@NAME: DOL-63x-mp
#@DESCRIPTION: Machine configuration for DOL-63x Max Performance variant

include conf/machine/dol-63x.inc
```

## conf/machine/dol-63x.inc
```bitbake
#@TYPE: Machine
#@NAME: DOL-63x
#@DESCRIPTION: Common machine configuration for all DOL-63x variants

include conf/machine/include/soc-family.inc

MACHINEOVERRIDES .= ":dol-63x"

MACHINE_EXTRA_RRECOMMENDS = " kernel-modules kernel-devicetree"

EXTRA_IMAGEDEPENDS += "virtual/bootloader"

DEFAULTTUNE = "cortexa9hf-neon"
include conf/machine/include/tune-cortexa9.inc

IMAGE_FSTYPES += "tar.bz2 ext4"

SERIAL_CONSOLES = "115200;ttymxc1"

PREFERRED_PROVIDER_virtual/bootloader ?= "barebox"

PREFERRED_PROVIDER_virtual/kernel ?= "linux-skov"

KERNEL_IMAGETYPE = "zImage"
KERNEL_DEVICETREE = "\
 imx6q-skov-dol63x-revA.dtb \
 imx6q-skov-dol63x-revB.dtb \
 imx6q-skov-dol63x-revC.dtb \
 imx6dl-skov-dol63x-revA.dtb \
 imx6dl-skov-dol63x-revB.dtb \
 imx6dl-skov-dol63x-revC.dtb \
 "

MACHINE_FEATURES = "usbgadget usbhost vfat touchscreen serial rtc"

SOC_FAMILY = "mx6"
MACHINE_SOCARCH = "${TUNE_PKGARCH}-mx6"
MACHINE_ARCH_FILTER = "virtual/kernel"
PACKAGE_EXTRA_ARCHS_append = " ${MACHINE_SOCARCH}"
```

## conf/machine/imx6-cpu.conf
```bitbake
#@TYPE: Machine
#@NAME: IMX6
#@DESCRIPTION: Common machine configuration for all IMX6 variants

require conf/machine/include/soc-family.inc

MACHINEOVERRIDES =. ":imx6-cpu"

MACHINE_EXTRA_RRECOMMENDS = " kernel-modules kernel-devicetree \
                              firmware-imx-vpu-imx6d firmware-imx-vpu-imx6q \
"

EXTRA_IMAGECMD:squashfs = "-comp zstd -b 128K -no-xattrs"
EXTRA_IMAGEDEPENDS += "virtual/bootloader"

DEFAULTTUNE = "cortexa9thf-neon"
require conf/machine/include/arm/armv7a/tune-cortexa9.inc

IMAGE_FSTYPES += "tar.bz2 squashfs"

SERIAL_CONSOLES = "115200;ttymxc1"

PREFERRED_PROVIDER_virtual/egl:mx6-generic-bsp  ?= "mesa"
PREFERRED_PROVIDER_virtual/libgl:mx6-generic-bsp  ?= "mesa"
PREFERRED_PROVIDER_virtual/libgles1:mx6-generic-bsp  ?= "mesa"
PREFERRED_PROVIDER_virtual/libgles2:mx6-generic-bsp  ?= "mesa"
PREFERRED_PROVIDER_virtual/libgles3:mx6-generic-bsp  ?= "mesa"

PREFERRED_PROVIDER_virtual/wpebackend ?= "wpebackend-fdo"

PREFERRED_PROVIDER_virtual/bootloader ?= "barebox"

PREFERRED_PROVIDER_virtual/kernel ?= "linux-skov"

BAREBOX_IMAGE = "barebox-skov-imx6.img"
BAREBOX_PADDING_SKIP = "1024"
BAREBOX_PADDING_OFFSET = "1"

KERNEL_IMAGETYPE = "zImage"
KERNEL_DEVICETREE = "\
 nxp/imx/imx6dl-skov-revc-lt2.dtb \
 nxp/imx/imx6dl-skov-revc-lt6.dtb \
 nxp/imx/imx6q-skov-revc-lt2.dtb \
 nxp/imx/imx6q-skov-revc-lt6.dtb \
 nxp/imx/imx6q-skov-reve-mi1010ait-1cp1.dtb \
 "

MACHINE_FEATURES = "usbgadget usbhost vfat touchscreen serial rtc"

SOC_FAMILY = "mx6-generic-bsp"
MACHINE_SOCARCH = "${TUNE_PKGARCH}-mx6-generic-bsp"
MACHINE_ARCH_FILTER = "virtual/kernel"
PACKAGE_EXTRA_ARCHS:append = " ${MACHINE_SOCARCH}"

PREFERRED_PROVIDER_virtual/java-native ?= "cacao-native"
PREFERRED_PROVIDER_virtual/java-initial-native ?= "cacao-initial-native"

PREFERRED_PROVIDER_virtual/rauc-signing ?= "skov-rauc-keys-native"

# The root-FS' fstab has an entry regarding /home whose source device is
# determined dynamically based upon setting the image's target medium. It is set
# to "NAND" per default here and can be overwritten to be "SD" in your
# local.conf or from the bitbake-commandline via
#   $ env TARGET_MEDIUM="SD" BB_ENV_PASSTHROUGH_ADDITIONS="$BB_ENV_PASSTHROUGH_ADDITIONS" bitbake [...]
TARGET_MEDIUM ?= "NAND"

# Although we can not use the factory install script on the imx6-cpu let's
# nevertheless formally define the bundle it would install per default.
FACTORY_INSTALL_BUNDLE ?= "tc-ci-bundle"

PREFERRED_RPROVIDER_ssh ?= "openssh"
```

## conf/machine/imx8-cpu.conf
```bitbake
#@TYPE: Machine
#@NAME: imx8-cpu
#@DESCRIPTION: Machine configuration for Skov's imx8-cpu (i.MX8MPlus)

SOC_FAMILY = "mx8m-generic-bsp"
require conf/machine/include/soc-family.inc

DEFAULTTUNE = "cortexa53-crypto"
require conf/machine/include/arm/armv8a/tune-cortexa53.inc

MACHINE_FEATURES = "usbgadget usbhost vfat touchscreen serial rtc"
MACHINE_EXTRA_RRECOMMENDS = " \
    kernel-modules \
    kernel-devicetree \
"

MACHINE_SOCARCH = "${TUNE_PKGARCH}-mx8mp"
MACHINE_ARCH_FILTER = "virtual/kernel"
PACKAGE_EXTRA_ARCHS:append = " ${MACHINE_SOCARCH}"

EXTRA_IMAGEDEPENDS += "virtual/bootloader"

PREFERRED_PROVIDER_virtual/bootloader ?= "barebox"
BAREBOX_IMAGE = "barebox-skov-imx8mp.img"
BAREBOX_PADDING_SKIP = "32768"
BAREBOX_PADDING_OFFSET = "32"

PREFERRED_PROVIDER_virtual/egl:mx8 ?= "mesa"
PREFERRED_PROVIDER_virtual/libgl:mx8 ?= "mesa"
PREFERRED_PROVIDER_virtual/libgles1:mx8 ?= "mesa"
PREFERRED_PROVIDER_virtual/libgles2:mx8 ?= "mesa"
PREFERRED_PROVIDER_virtual/libgles3:mx8 ?= "mesa"
SERIAL_CONSOLES = "115200;ttymxc1"

PREFERRED_PROVIDER_virtual/wpebackend ?= "wpebackend-fdo"
PREFERRED_PROVIDER_virtual/kernel ?= "linux-skov"

PREFERRED_PROVIDER_virtual/java-native ?= "cacao-native"
PREFERRED_PROVIDER_virtual/java-initial-native ?= "cacao-initial-native"

KERNEL_IMAGETYPE = "Image"
KERNEL_DEVICETREE = " \
    freescale/imx8mp-skov-basic.dtb \
    freescale/imx8mp-skov-revb-hdmi.dtb \
    freescale/imx8mp-skov-revb-lt6.dtb \
    freescale/imx8mp-skov-revb-mi1010ait-1cp1.dtb \
    freescale/imx8mp-skov-revc-bd500.dtb \
    freescale/imx8mp-skov-revc-jutouch-jt070tm041.dtb \
    freescale/imx8mp-skov-revc-jutouch-jt101tm023.dtb \
"

DDR_FIRMWARE_NAME = " \
	lpddr4_pmu_train_1d_imem.bin \
	lpddr4_pmu_train_1d_dmem.bin \
	lpddr4_pmu_train_2d_imem.bin \
	lpddr4_pmu_train_2d_dmem.bin \
"

IMAGE_FSTYPES += "tar.bz2 ext4"

# Our image recipes utilizing wic are parameterized in a way that allows to
# choose if the produced wic-image is suited for installation onto the eMMC or
# onto an SD-card (additionally to the image layout the fstab entry for /home is
# adjusted accordingly). It is set to "eMMC" per default here and can be
# overwritten to be "SD" in your local.conf or from the bitbake-commandline via
#   $ env TARGET_MEDIUM="SD" BB_ENV_PASSTHROUGH_ADDITIONS="$BB_ENV_PASSTHROUGH_ADDITIONS TARGET_MEDIUM" bitbake [...]
TARGET_MEDIUM ?= "eMMC"

PREFERRED_RPROVIDER_ssh ?= "openssh"
```

## conf/machine/imx8eval.conf
```bitbake
#@TYPE: Machine
#@NAME: imx8eval
#@DESCRIPTION: Machine configuration for the 8MPLUSLPD4-EVK (i.MX8MPlus)

SOC_FAMILY = "mx8"
include conf/machine/include/soc-family.inc

DEFAULTTUNE = "cortexa53-crypto"
include conf/machine/include/tune-cortexa53.inc

MACHINEOVERRIDES .= ":nxp-imx8mp-evk"
MACHINE_FEATURES = "usbgadget usbhost vfat touchscreen serial rtc"
MACHINE_EXTRA_RRECOMMENDS = " \
    kernel-modules \
    kernel-devicetree \
    firmware-imx-vpu-imx8 \
    linux-firmware-imx-sdma-imx7d \
"

MACHINE_SOCARCH = "${TUNE_PKGARCH}-mx8mp"
MACHINE_ARCH_FILTER = "virtual/kernel"
PACKAGE_EXTRA_ARCHS_append = " ${MACHINE_SOCARCH}"

EXTRA_IMAGEDEPENDS += "virtual/bootloader"

PREFERRED_PROVIDER_virtual/bootloader ?= "barebox"
BAREBOX_IMAGE = "barebox-nxp-imx8mp-evk.img"
BAREBOX_PADDING_SKIP = "32768"
BAREBOX_PADDING_OFFSET = "32"

PREFERRED_PROVIDER_virtual/egl_mx8 ?= "mesa"
PREFERRED_PROVIDER_virtual/libgl_mx8 ?= "mesa"
PREFERRED_PROVIDER_virtual/libgles1_mx8 ?= "mesa"
PREFERRED_PROVIDER_virtual/libgles2_mx8 ?= "mesa"
PREFERRED_PROVIDER_virtual/wpebackend ?= "wpebackend-fdo"
PREFERRED_PROVIDER_virtual/kernel ?= "linux-skov"

PREFERRED_PROVIDER_virtual/java-native ?= "cacao-native"
PREFERRED_PROVIDER_virtual/java-initial-native ?= "cacao-initial-native"

KERNEL_IMAGETYPE = "Image"
KERNEL_DEVICETREE = " \
    freescale/imx8mp-evk.dtb \
"

DDR_FIRMWARE_NAME = " \
	lpddr4_pmu_train_1d_imem.bin \
	lpddr4_pmu_train_1d_dmem.bin \
	lpddr4_pmu_train_2d_imem.bin \
	lpddr4_pmu_train_2d_dmem.bin \
"

IMAGE_FSTYPES += "tar.bz2 ext4"
```

## conf/machine/imx8s-cpu.conf
```bitbake
#@TYPE: Machine
#@NAME: imx8s-cpu
#@DESCRIPTION: Machine configuration for Skov's imx8s-cpu (i.MX8MPlus) secure boot

SOC_FAMILY = "mx8m-generic-bsp"
require conf/machine/include/soc-family.inc

DEFAULTTUNE = "cortexa53-crypto"
require conf/machine/include/arm/armv8a/tune-cortexa53.inc

MACHINE_FEATURES = "usbgadget usbhost vfat touchscreen serial rtc habv4"
MACHINE_EXTRA_RRECOMMENDS = " \
    kernel-modules \
"

# Inactivate the recommendation weakly set in poky's kernel.bbclass [1] to get
# rid of kernel images in the root-FS (/boot/*Image*) as they are separately
# stored via FIT-images in dedicated partitions.
#
# [1] https://git.yoctoproject.org/poky/tree/meta/classes-recipe/kernel.bbclass?h=mickledore-4.2.3&id=aa63b25cbe25#n681
BAD_RECOMMENDATIONS = "kernel-image-*"

MACHINE_SOCARCH = "${TUNE_PKGARCH}-mx8mp"
MACHINE_ARCH_FILTER = "virtual/kernel"
PACKAGE_EXTRA_ARCHS:append = " ${MACHINE_SOCARCH}"

EXTRA_IMAGEDEPENDS += "virtual/bootloader"

PREFERRED_PROVIDER_virtual/bootloader ?= "barebox"
BAREBOX_IMAGE = "barebox-skov-imx8mp-s.img"
BAREBOX_PADDING_SKIP = "32768"
BAREBOX_PADDING_OFFSET = "32"

PREFERRED_PROVIDER_virtual/egl:mx8 ?= "mesa"
PREFERRED_PROVIDER_virtual/libgl:mx8 ?= "mesa"
PREFERRED_PROVIDER_virtual/libgles1:mx8 ?= "mesa"
PREFERRED_PROVIDER_virtual/libgles2:mx8 ?= "mesa"
PREFERRED_PROVIDER_virtual/libgles3:mx8 ?= "mesa"
SERIAL_CONSOLES = "115200;ttymxc1"

PREFERRED_PROVIDER_virtual/wpebackend ?= "wpebackend-fdo"
PREFERRED_PROVIDER_virtual/kernel ?= "linux-skov"

PREFERRED_PROVIDER_virtual/java-native ?= "cacao-native"
PREFERRED_PROVIDER_virtual/java-initial-native ?= "cacao-initial-native"

PREFERRED_PROVIDER_virtual/rauc-signing ?= "ptx-dev-keys-native"

KERNEL_IMAGETYPE = "Image"
KERNEL_DEVICETREE = " \
    freescale/imx8mp-skov-basic.dtb \
    freescale/imx8mp-skov-revb-hdmi.dtb \
    freescale/imx8mp-skov-revb-lt6.dtb \
    freescale/imx8mp-skov-revb-mi1010ait-1cp1.dtb \
    freescale/imx8mp-skov-revc-bd500.dtb \
    freescale/imx8mp-skov-revc-jutouch-jt070tm041.dtb \
    freescale/imx8mp-skov-revc-jutouch-jt101tm023.dtb \
"

# OP-TEE shall be placed 32 MiB before the end of the RAM. According to the
# boards devicetree the RAM starts at 0x40000000 which for 2 GiB of memory
# results in: 0x40000000 + 2 GiB - 32 MiB = 0xbe000000. Choose 2 MiB for
# OP-TEE's shared memory area so that 30 MiB remain for OP-TEE's core.
OPTEE_LOADADDR = "0xbe000000"
OPTEE_CORE_SIZE = "0x01e00000"
OPTEE_SHMEM_SIZE = "0x00200000"

DDR_FIRMWARE_NAME = " \
	lpddr4_pmu_train_1d_imem.bin \
	lpddr4_pmu_train_1d_dmem.bin \
	lpddr4_pmu_train_2d_imem.bin \
	lpddr4_pmu_train_2d_dmem.bin \
"

IMAGE_FSTYPES += "tar.bz2 ext4"

# Choose defaults in the context of dm-verity protected root-FSs
VERITY_IMAGE_FSTYPE = "ext4"
VERITY_IMAGE_SUFFIX = ".verity"

# Our image recipes utilizing wic are parameterized in a way that allows to
# choose if the produced wic-image is suited for installation onto the eMMC or
# onto an SD-card (additionally to the image layout the fstab entry for /home is
# adjusted accordingly). It is set to "eMMC" per default here and can be
# overwritten to be "SD" in your local.conf or from the bitbake-commandline via
#   $ env TARGET_MEDIUM="SD" BB_ENV_PASSTHROUGH_ADDITIONS="$BB_ENV_PASSTHROUGH_ADDITIONS TARGET_MEDIUM" bitbake [...]
TARGET_MEDIUM ?= "eMMC"

PREFERRED_RPROVIDER_ssh ?= "openssh"
```

## conf/machine/skov-bsp.conf
```bitbake
#@TYPE: Machine
#@NAME: skov-bsp

#@DESCRIPTION: Machine configuration for skov-bsp systems


MACHINE_EXTRA_RRECOMMENDS = " kernel-modules kernel-devicetree"

EXTRA_IMAGEDEPENDS += "u-boot"

DEFAULTTUNE ?= "cortexa8hf-neon"
include conf/machine/include/tune-cortexa8.inc

IMAGE_FSTYPES += "tar.bz2 jffs2"
EXTRA_IMAGECMD_jffs2 = "-lnp "

SERIAL_CONSOLE = "115200 ttyO0"

PREFERRED_PROVIDER_virtual/kernel ?= "linux-yocto-custom"


KERNEL_IMAGETYPE = "uImage"
KERNEL_DEVICETREE = "am335x-bone.dtb am335x-boneblack.dtb"
KERNEL_EXTRA_ARGS += "LOADADDR=${UBOOT_ENTRYPOINT}"

SPL_BINARY = "MLO"
UBOOT_SUFFIX = "img"
UBOOT_MACHINE = "am335x_evm_config"
UBOOT_ENTRYPOINT = "0x80008000"
UBOOT_LOADADDRESS = "0x80008000"

MACHINE_FEATURES = "usbgadget usbhost vfat alsa"

IMAGE_BOOT_FILES ?= "u-boot.${UBOOT_SUFFIX} MLO"
```
